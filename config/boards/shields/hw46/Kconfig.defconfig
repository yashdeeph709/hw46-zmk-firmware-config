## config/boards/shields/hw46/Kconfig.defconfig
```kconfig
if SHIELD_HW46_LEFT

config ZMK_KEYBOARD_NAME
    default "HW46"

config ZMK_SPLIT_ROLE_CENTRAL
    default y

endif

if SHIELD_HW46_LEFT || SHIELD_HW46_RIGHT

config ZMK_SPLIT
    default y

endif
```

## config/boards/shields/hw46/Kconfig.shield
```kconfig
config SHIELD_HW46_LEFT
    def_bool $(shields_list_contains,hw46_left)

config SHIELD_HW46_RIGHT
    def_bool $(shields_list_contains,hw46_right)
```
